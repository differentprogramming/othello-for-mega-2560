#include <stdint.h>

#define INT_MAX 2147483647

// consolegame.cpp : Defines the entry point for the console application.
//

#define __min(x,y) (x)<(y)?(x):(y)

char *gets(char * b,size_t maxlen)
{
  int len=0;
  while(Serial.available()==0) delay(100);
  while (Serial.available()!=0 && len<(int)maxlen-1){
    b[len++]=Serial.read();
    delay(2);//I seem to have to delay enough to get the next byte at 9600 baud
  }
  b[len]=0;
  return b;
}
int blink_counter = 20000;
bool blink_state=false;
void blink()
{
  if (blink_counter--<1) {
    if (blink_state) digitalWrite(13, LOW);
    else digitalWrite(13, HIGH);
    blink_state = !blink_state;
    blink_counter = 20000;
  }
}


#define pgm_read_word_far_index(address_long,index) pgm_read_word_far((far_ptr_t)(address_long)+((index)<<1))

//#define NO_OPTIMIZATION

#define Square uint8_t

#define SafetyT unsigned

#define BoardLine unsigned


typedef SafetyT CompressedBoard[8];

typedef Square BoardArray[100];
struct ValTriple { int8_t pos; int8_t dir; int8_t len; };
const ValTriple Valuations[] =
{
  { 81,1,8 },{ 71,1,8 },
  { 61,1,8 },{ 51,1,8 },
  { 41,1,8 },{ 31,1,8 },
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  { 0,0,0 }
};
const SafetyT compress_a[256] PROGMEM = {
0, 1, 2, 3, 3, 4, 5, 6, 6, 7, 8, 9, 9, 10, 11, 12, 9, 10, 11, 12, 12, 13, 14, 15, 15, 16, 17, 18, 18, 19, 20, 21, 
18, 19, 20, 21, 21, 22, 23, 24, 24, 25, 26, 27, 27, 28, 29, 30, 27, 28, 29, 30, 30, 31, 32, 33, 33, 34, 35, 36, 36, 37, 38, 39, 
27, 28, 29, 30, 30, 31, 32, 33, 33, 34, 35, 36, 36, 37, 38, 39, 36, 37, 38, 39, 39, 40, 41, 42, 42, 43, 44, 45, 45, 46, 47, 48, 
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99, 100, 101, 102, 102, 103, 104, 105, 105, 106, 107, 108, 108, 109, 110, 111, 108, 109, 110, 111, 111, 112, 113, 114, 114, 115, 116, 117, 117, 118, 119, 120, 
};

const SafetyT compress_b[256] PROGMEM = 
{
81, 162, 243, 243, 324, 405, 486, 486, 567, 648, 729, 729, 810, 891, 972, 729, 810, 891, 972, 972, 1053, 1134, 1215, 1215, 1296, 1377, 1458, 1458, 1539, 1620, 1701, 
1458, 1539, 1620, 1701, 1701, 1782, 1863, 1944, 1944, 2025, 2106, 2187, 2187, 2268, 2349, 2430, 2187, 2268, 2349, 2430, 2430, 2511, 2592, 2673, 2673, 2754, 2835, 2916, 2916, 2997, 3078, 3159, 
2187, 2268, 2349, 2430, 2430, 2511, 2592, 2673, 2673, 2754, 2835, 2916, 2916, 2997, 3078, 3159, 2916, 2997, 3078, 3159, 3159, 3240, 3321, 3402, 3402, 3483, 3564, 3645, 3645, 3726, 3807, 3888, 
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8019, 8100, 8181, 8262, 8262, 8343, 8424, 8505, 8505, 8586, 8667, 8748, 8748, 8829, 8910, 8991, 8748, 8829, 8910, 8991, 8991, 9072, 9153, 9234, 9234, 9315, 9396, 9477, 9477, 9558, 9639, 9720, 
};

void init_compress()
{
}
//reduce cache pressure by converting base 3 index to compressed form
inline SafetyT compress3(BoardLine c)
{
  return pgm_read_word(&compress_a[c & 255]) + pgm_read_word(&compress_b[c >> 8]);
}


const int QUIESCENT_DEPTH = 0;

const Square Out = 4;
const Square Empty = 0;
const Square White = 1;
const Square Black = 2;
//black p
const int8_t simple_sum[] = { 0,1,-1,0,0 };
const int empty_sum[5] = { 1,0,0,0,0 };

typedef Square BoardLineArray[10];
const int NUMDIR = 8;
const int Directions[] = { 11,9,-11,-9,1,-1,10,-10,0 };
const int LineDirections[] = { 1,-1,0 };

const SafetyT SafetyT1[3] PROGMEM = {
  3,
  1, 2,
};
const SafetyT SafetyT2[9] PROGMEM = {
  15,
  13, 14, 7, 5, 6, 11, 9, 10,
};
const SafetyT SafetyT3[27] PROGMEM = {
  63,
  61, 62, 63, 53, 62, 63, 61, 58, 31, 29, 30, 23, 21, 22, 31, 25, 26, 47, 45, 46, 47, 37, 38, 43, 41, 42,
};
const SafetyT SafetyT4[81] PROGMEM = {
  255,
  253, 254, 255, 245, 254, 255, 253, 250, 255, 253, 254, 255, 213, 254, 255, 249, 250, 255, 253, 254, 255, 245, 246, 255, 253, 234, 127,
  125, 126, 127, 117, 126, 127, 125, 122, 95, 93, 94, 87, 85, 86, 95, 89, 90, 127, 125, 126, 111, 101, 102, 127, 105, 106, 191,
  189, 190, 191, 181, 190, 191, 189, 186, 191, 189, 190, 191, 149, 150, 159, 153, 154, 175, 173, 174, 175, 165, 166, 171, 169, 170,
};
const SafetyT SafetyT5[243] PROGMEM = {
  1023,
  1021, 1022, 1023, 1013, 1022, 1023, 1021, 1018, 1023, 1021, 1022, 1023, 981, 1022, 1023, 1021, 1018, 1023, 1021, 1022, 1023, 1013, 1022, 1023, 1021, 1002, 1023,
  1021, 1022, 1023, 1013, 1022, 1023, 1021, 1018, 1023, 1021, 1022, 1023, 853, 1022, 1023, 1017, 1018, 1023, 1021, 1022, 1007, 997, 998, 1023, 1001, 1002, 1023,
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  701, 702, 703, 693, 702, 703, 701, 698, 703, 701, 702, 703, 661, 662, 671, 665, 666, 687, 685, 686, 687, 677, 678, 683, 681, 682,
};
const SafetyT SafetyT6[729] PROGMEM = {
  4095,
  4093, 4094, 4095, 4085, 4094, 4095, 4093, 4090, 4095, 4093, 4094, 4095, 4053, 4094, 4095, 4093, 4090, 4095, 4093, 4094, 4095, 4085, 4094, 4095, 4093, 4074, 4095,
  4093, 4094, 4095, 4085, 4094, 4095, 4093, 4090, 4095, 4093, 4094, 4095, 3925, 4094, 4095, 4093, 4090, 4095, 4093, 4094, 4095, 4085, 4086, 4095, 4093, 4074, 4095,
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  2749, 2750, 2751, 2741, 2750, 2751, 2749, 2746, 2751, 2749, 2750, 2751, 2709, 2710, 2719, 2713, 2714, 2735, 2733, 2734, 2735, 2725, 2726, 2731, 2729, 2730,
};
const SafetyT SafetyT7[2187] PROGMEM = {
  16383,
  16381, 16382, 16383, 16373, 16382, 16383, 16381, 16378, 16383, 16381, 16382, 16383, 16341, 16382, 16383, 16381, 16378, 16383, 16381, 16382, 16383, 16373, 16382, 16383, 16381, 16362, 16383,
  16381, 16382, 16383, 16373, 16382, 16383, 16381, 16378, 16383, 16381, 16382, 16383, 16213, 16382, 16383, 16381, 16378, 16383, 16381, 16382, 16383, 16373, 16382, 16383, 16381, 16362, 16383,
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  10941, 10942, 10943, 10933, 10942, 10943, 10941, 10938, 10943, 10941, 10942, 10943, 10901, 10902, 10911, 10905, 10906, 10927, 10925, 10926, 10927, 10917, 10918, 10923, 10921, 10922,
};
const SafetyT SafetyT8[6561] PROGMEM = {
  65535,
  65533, 65534, 65535, 65525, 65534, 65535, 65533, 65530, 65535, 65533, 65534, 65535, 65493, 65534, 65535, 65533, 65530, 65535, 65533, 65534, 65535, 65525, 65534, 65535, 65533, 65514, 65535,
  65533, 65534, 65535, 65525, 65534, 65535, 65533, 65530, 65535, 65533, 65534, 65535, 65365, 65534, 65535, 65533, 65530, 65535, 65533, 65534, 65535, 65525, 65534, 65535, 65533, 65514, 65535,
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  43709, 43710, 43711, 43701, 43710, 43711, 43709, 43706, 43711, 43709, 43710, 43711, 43669, 43670, 43679, 43673, 43674, 43695, 43693, 43694, 43695, 43685, 43686, 43691, 43689, 43690,
};

#define far_ptr_t unsigned long
const SafetyT * safety_add[8] =
{
  SafetyT1,
  SafetyT2,
  SafetyT3,
  SafetyT4,
  SafetyT5,
  SafetyT6,
  SafetyT7,
  SafetyT8
};

SafetyT safety(int a, int i)
{
  return pgm_read_word(&(safety_add[a])[i]) ;
  //return pgm_read_word_far_index(safety_add[a], i);
}
//paired so direction and len are the same except the last pair where only len is the same





/*x,0,x,x,x,x,x,x,x,2,4,6*/
const int shifts[] = { -1,0,-1,-1,-1,-1,-1,-1,-1,2,4,6 };

Square undo_buffer_array[64 * 10];
Square *undo_buffer = &undo_buffer_array[0];

typedef int32_t ValuationArray[100];
ValuationArray aValuationArray;


inline Square other_color(Square c) { return (Black + White) ^ c; }

//note white is positive, black negative
//add number of pieces to this
int8_t Values[256];
const int8_t values_by_color[] = { -64,-32,-16,-8,0,8,16,32,64 };
void initValues()
{
  for (int i = 0;i < 256;++i) {
    int count_black = 0;
    int count_white = 0;
    int count_ambig = 0;
    for (int p = 0;p < 4;++p) {
      int at = (i >> (p + p)) & 3;
      switch (at) {
      case 1:
        if (count_black) {
          --count_black;
          ++count_ambig;
        }
        else ++count_white;
        break;
      case 2:
        if (count_white) {
          --count_white;
          ++count_ambig;
        }
        else ++count_black;
        break;
      case 3:
        ++count_ambig;
      }

    }
    Values[i] = values_by_color[count_white - count_black + 4] >> count_ambig;
  }
}
template <int DIR>
class Move {
public:
  static bool check(int pos, Square color, Square other, Square *r)
  {
    if (r[DIR] == other) {
      if (r[2 * DIR] == other) {
        if (r[3 * DIR] == other) {
          if (r[4 * DIR] == other) {
            if (r[5 * DIR] == other) {
              if (r[6 * DIR] == other) {
                if (r[7 * DIR] == color) {
                  return true;
                }
              }
              else if (r[6 * DIR] == color) {
                return true;
              }

            }
            else if (r[5 * DIR] == color) {
              return true;
            }
          }
          else if (r[4 * DIR] == color) {
            return true;
          }
        }
        else if (r[3 * DIR] == color) {
          return true;
        }
      }
      else if (r[2 * DIR] == color) {
        return true;
      }
    }
    return false;
  }
  static int move(Square *&undo, int pos, Square color, Square other, Square *r)
  {
    blink();
//  Serial.print(F("move "));Serial.print(pos);Serial.print(F(" "));;Serial.println(color);
  //delay(2000);
    if (r[DIR] == other) {
      if (r[2 * DIR] == other) {
        if (r[3 * DIR] == other) {
          if (r[4 * DIR] == other) {
            if (r[5 * DIR] == other) {
              if (r[6 * DIR] == other) {
                if (r[7 * DIR] == color) {
                  r[6 * DIR] = r[5 * DIR] = r[4 * DIR] = r[3 * DIR] = r[2 * DIR] = r[DIR] = color;
                  undo[5] = 6 * DIR + pos;
                  undo[4] = 5 * DIR + pos;
                  undo[3] = 4 * DIR + pos;
                  undo[2] = 3 * DIR + pos;
                  undo[1] = 2 * DIR + pos;
                  undo[0] = DIR + pos;
                  undo += 6;
                  return 1;
                }
              }
              else if (r[6 * DIR] == color) {
                r[5 * DIR] = r[4 * DIR] = r[3 * DIR] = r[2 * DIR] = r[DIR] = color;
                undo[4] = 5 * DIR + pos;
                undo[3] = 4 * DIR + pos;
                undo[2] = 3 * DIR + pos;
                undo[1] = 2 * DIR + pos;
                undo[0] = DIR + pos;
                undo += 5;
                return 1;
              }

            }
            else if (r[5 * DIR] == color) {
              r[4 * DIR] = r[3 * DIR] = r[2 * DIR] = r[DIR] = color;
              undo[3] = 4 * DIR + pos;
              undo[2] = 3 * DIR + pos;
              undo[1] = 2 * DIR + pos;
              undo[0] = DIR + pos;
              undo += 4;
              return 1;
            }
          }
          else if (r[4 * DIR] == color) {
            r[3 * DIR] = r[2 * DIR] = r[DIR] = color;
            undo[2] = 3 * DIR + pos;
            undo[1] = 2 * DIR + pos;
            undo[0] = DIR + pos;
            undo += 3;
            return 1;
          }
        }
        else if (r[3 * DIR] == color) {
          r[2 * DIR] = r[DIR] = color;
          undo[1] = 2 * DIR + pos;
          undo[0] = DIR + pos;
          undo += 2;
          return 1;
        }
      }
      else if (r[2 * DIR] == color) {

        r[DIR] = color;
        undo[0] = DIR + pos;
        undo += 1;
        return 1;
      }
    }
    return 0;
  }
};
bool fast_move_check(int pos, Square color, Square *board)
{
  if (board[pos] != Empty) return false;
  const Square other = other_color(color);
  Square *r = &board[pos];
  return Move<1>::check(pos, color, other, r) ||
    Move<-1>::check(pos, color, other, r) ||
    Move<10>::check(pos, color, other, r) ||
    Move<-10>::check(pos, color, other, r) ||
    Move<11>::check(pos, color, other, r) ||
    Move<-11>::check(pos, color, other, r) ||
    Move<9>::check(pos, color, other, r) ||
    Move<-9>::check(pos, color, other, r);
}

bool fast_move(Square *&undo, int pos, Square color, Square *board)
{
  if (board[pos] != Empty) return false;
  const Square other = other_color(color);
  Square *r = &board[pos];
  Square *u = undo;
  if (0 != (Move<1>::move(u, pos, color, other, r) |
    Move<-1>::move(u, pos, color, other, r) |
    Move<10>::move(u, pos, color, other, r) |
    Move<-10>::move(u, pos, color, other, r) |
    Move<11>::move(u, pos, color, other, r) |
    Move<-11>::move(u, pos, color, other, r) |
    Move<9>::move(u, pos, color, other, r) |
    Move<-9>::move(u, pos, color, other, r)))
  {
    Square t = u-undo;
    *u++ = t;
    *u++ = pos;
//    Serial.print(F("Record undo at: "));Serial.print(pos); Serial.print(F(" len: "));Serial.println(u-undo);
    board[pos] = color;
    undo = u;
    return true;
  }
  return false;

}
bool move(Square *&undo, int pos, Square color, Square *board, const int *directions, bool check = false)
{
  if (board[pos] != Empty) return false;
  Square other = other_color(color);
  Square *u = undo;
  Square *r = &board[pos];
  for (int d = 0;directions[d];++d) {
    int dir = directions[d];
    if (r[dir] == other) {
      Square * o = &r[dir];
      while (o[dir] == other) o += dir;
      if (o[dir] == color) {
        if (check) return true;
        do {
          *u++ = o - board;
          *o = color;
          o -= dir;
        } while (o != r);
      }
    }
  }
  if (u != undo) {
    Square t =  u - undo;
  
    *u++ = t;
    *u++ = pos;
    board[pos] = color;
    undo = u;
    return true;
  }
  return false;
}
void dump_undos()
{
 
  return;
  Square *u = undo_buffer;
  Serial.println(F("***Undo dump"));
  while (u!=&undo_buffer_array[0] && u!=&undo_buffer_array[1] && u!=u!=&undo_buffer_array[-1] ){
    Serial.print(F("undo at "));
    Serial.print(*(--u));
    int num = *--u;
    Serial.print(F(" "));
    Serial.print(num);
    Serial.println(F(" flips"));
    while (num-- > 0) {
      Serial.print(F(" flip"));
      Serial.print(*u);
      --u;
    }
    Serial.println(F(""));
  }
  Serial.println(F("***End undo dump"));
}
void undo(Square *&undo, Square *board)
{
  if (undo_buffer == &undo_buffer_array[0]) {
//    Serial.println(F("undo nothing"));
    return;
  }
  if (undo != undo_buffer){
//    Serial.println(F("*********************************oh shit*******************"));
//    abort();
  }
  Square *u = undo;
//  Serial.print(F("undo at "));
//  Serial.println(*(u-1));
  board[*--u] = Empty;
  int num = *--u;
//  Serial.print(num);
//  Serial.println(F(" flips"));
  while (num-- > 0) {
//    Serial.print(F(" flip"));
//    Serial.println(*u);
  
    board[*--u] ^= (White + Black);
  }
  undo = u;
}

static int8_t blacklru[1][64] = { {
    11,18,81,88,
    13,16,38,68,86,83,61,31,
    14,15,48,58,84,85,41,51,
    33,34,35,36,43,44,45,46,53,54,55,56,63,64,65,66,
    23,24,25,26,37,47,57,67,73,74,75,76,32,42,52,62,
    12,21,17,28,78,87,82,71,
    22,27,77,72
  } };

static int8_t whitelru[1][64] = { {

    11,18,81,88,
    13,16,38,68,86,83,61,31,
    14,15,48,58,84,85,41,51,
    33,34,35,36,43,44,45,46,53,54,55,56,63,64,65,66,
    23,24,25,26,37,47,57,67,73,74,75,76,32,42,52,62,
    12,21,17,28,78,87,82,71,
    22,27,77,72
  } };



static int8_t endgame_blacklru[1][64] = { {
    11,18,81,88,
    13,16,38,68,86,83,61,31,
    14,15,48,58,84,85,41,51,
    33,34,35,36,43,44,45,46,53,54,55,56,63,64,65,66,
    23,24,25,26,37,47,57,67,73,74,75,76,32,42,52,62,
    12,21,17,28,78,87,82,71,
    22,27,77,72
  } };

static int8_t endgame_whitelru[1][64] = { {

    11,18,81,88,
    13,16,38,68,86,83,61,31,
    14,15,48,58,84,85,41,51,
    33,34,35,36,43,44,45,46,53,54,55,56,63,64,65,66,
    23,24,25,26,37,47,57,67,73,74,75,76,32,42,52,62,
    12,21,17,28,78,87,82,71,
    22,27,77,72
  } };

class Board {
public:
  Board() {
    for (int i = 0;i < 100;++i) board[i] = Empty;
    for (int i = 0;i < 9;++i) {
      board[90 - i * 10] = board[99 - i] = board[9 + i * 10] = board[i] = Out;
    }
    board[44] = board[55] = White;
    board[45] = board[54] = Black;
  }
  bool move(Square *&undo, int pos, Square color, bool check = false) {
    if (!check) return fast_move(undo, pos, color, board);
    return fast_move_check(pos, color, board);
  }
  void undo(Square *&undo, Square *board)
  {
    ::undo(undo, board);
  }
  BoardArray board;
  void print()
  {
    int b = 0, w = 0;
    const char *p = ".*Ox#";
    Serial.println(F("     1 2 3 4 5 6 7 8"));
    for (int i = 0;i < 100;++i) {
      if (i % 10 == 0) {
        if (i == 0 || i == 90) Serial.print(F("   "));
        else { Serial.print(F(" "));Serial.print(i / 10);Serial.print(F(" ")); }
      }
      Serial.write(p[board[i]]);Serial.write(' ');
      if (board[i] == Black) ++b;
      else if (board[i] == White) ++w;
      if (i % 10 == 9) {
        Serial.write('\n');
        }
      }

    Serial.print(b); Serial.print(F(" black pieces, ")); Serial.print(w); Serial.println(F(" white pieces"));
  }


  bool collect_primary_alphabeta(int32_t collect, int32_t collect_max, int32_t * move_collection, int depth, Square color, Square root_color, bool use_move_count);

  int32_t alphabeta(int &move_at, int depth, int32_t alpha, int32_t beta, Square color, Square root_color, bool use_move_count);
  int32_t movelist_alphabeta(int32_t* move_collection, int &move_at, int depth, Square color, Square root_color, bool use_move_count);
  int32_t endgame_alphabeta(int &move_at, int depth, int32_t alpha, int32_t beta, Square color, Square root_color, bool passed = false);


#ifdef NO_OPTIMIZATION
  bool next_move(int &move_number, int &move_at, Square color, int)
  {
    if (move_number > 63) return false;
    int at = move_at;
    do {
      if (move_number == 64) return false;
      at = (move_number & 7) + 11 + (move_number >> 3) * 10;
      ++move_number;
    } while (!move(undo_buffer, at, color));
 //   print();
    move_at = at;
    return true;
  }
  void killer(int move_number, Square color, int depth) {}
#else
  void killer2(int move_number, Square color, int depth)
  {
    if (move_number == 0) return;
    int8_t *lru;
    if (color == White)lru = endgame_whitelru[0];
    else lru = endgame_blacklru[0];
    int at = lru[move_number];
    for (int i = move_number - 1;i >= 0;--i) lru[i + 1] = lru[i];
    lru[0] = at;
  }
  void killer(int move_number, Square color, int depth)
  {
    if (move_number <= 1) return;
    int8_t *lru;
    if (color == White)lru = whitelru[0];
    else lru = blacklru[0];
    int at = lru[move_number];
    int a0 = lru[0];
    int a1 = lru[move_number >> 1];

    lru[0] = at;
    lru[move_number >> 1] = a0;
    lru[move_number] = a1;
  }
  void endgame_killer(int move_number, Square color, int depth)
  {
    static int32_t countdown = 100000;
    if (countdown) {
      --countdown;
      return killer2(move_number, color, depth);
    }
    if (move_number <= 1) return;
    int8_t *lru;
    if (color == White)lru = endgame_whitelru[0];
    else lru = endgame_blacklru[0];
    int at = lru[move_number];
    int a0 = lru[0];
    int a1 = lru[move_number >> 1];

    lru[0] = at;
    lru[move_number >> 1] = a0;
    lru[move_number] = a1;
  }


  bool next_move(int &move_number, int &move_at, Square color, int depth)
  {
    if (move_number > 63) return false;
    int at;
    do {
      if (move_number == 64) return false;
      //at = (move_number >> 3) * 10 + (move_number & 7) + 11;
      //++move_number;
      if (color == White)at = whitelru[0][move_number++];
      else at = blacklru[0][move_number++];
    } while (!move(undo_buffer, at, color));
    move_at = at;
    return true;
  }
  bool endgame_next_move(int &move_number, int &move_at, Square color, int depth)
  {
    if (move_number > 63) return false;
    int at;
    do {
      if (move_number == 64) return false;
      //at = (move_number >> 3) * 10 + (move_number & 7) + 11;
      //++move_number;
      if (color == White)at = endgame_whitelru[0][move_number++];
      else at = endgame_blacklru[0][move_number++];
    } while (!move(undo_buffer, at, color));
    move_at = at;
    return true;
  }
#endif
  bool next_move_not_in(int32_t *saved_moves, int &move_number, int &move_at, Square color, int depth)
  {
    while (next_move(move_number, move_at, color, depth)) {
      for (int i = 1;i < *saved_moves;++i) {
        if (saved_moves[i] == move_at) goto again;
      }
      return true;
    again:;
      undo(undo_buffer, board);
    }
    return false;
  }
  int find_move(int depth, Square color, bool use_move_count);
  bool can_move(Square color)
  {
    blink();
//    Serial.print(F("Can move "));
//    Serial.println(color);
//    delay(300);

    for (int p = 11;p <= 88;++p) if (move(undo_buffer, p, color, true)) return true;
//    Serial.println(F("no moves"));
//    delay(300);
    return false;
  }

  bool end_of_game()
  {
    return !can_move(White) && !can_move(Black);
  }
  int forced_move(int & move_at, Square color)
  {
    int moves = 0;
    move_at = 0;
    for (int p = 11;p <= 88;++p) {
      if (move(undo_buffer, p, color, true)) {
        move_at = p;
        if (++moves == 2) return false;
      }
    }
    return true;
  }
  int count_moves(int & move_at, Square color)
  {
    int moves = 0;
    move_at = 0;
    for (int p = 11;p <= 88;++p) {
      if (move(undo_buffer, p, color, true)) {
        move_at = p;
        ++moves;
      }
    }
    return moves;
  }

  void input(Square color, const char *command = NULL)
  {
    do {
      char buf[20];
      print();
      if (color == White) Serial.print(F("White's"));
      else Serial.print(F("Black's"));
      Serial.print(F(" move (p for pass, u undo, a[n] auto, b[n] alt auto):"));
      if (command) strcpy(buf, command);
      else { gets(buf, sizeof(buf) - 1); Serial.println(F("")); }
      int i = -1;
      i=atoi(buf);
      if (buf[0] == 'p') return;

      if (buf[0] == 'a') {
        int m = find_move(buf[1] - '0', color, false);
        Serial.print(F("move at "));Serial.println(m);
        if (!move(undo_buffer, m, color)) {
          Serial.println(F("pass"));
        }
        return;

      }
      if (buf[0] == 'b') {
        int m = find_move(buf[1] - '0', color, true);
        Serial.print(F("move at "));Serial.println( m);
        if (!move(undo_buffer, m, color)) {
          Serial.println(F("pass."));
        }
        return;

      }

      if (buf[0] == 'u') {
        undo(undo_buffer, board);

        return;
      }
      if (i < 11 || i>99 || !move(undo_buffer, i, color)) {
        Serial.println(F("bad move."));
      }
      else return;
    } while (true);
  }
};

//note is singleton
class Valuator
{
public:

  BoardLineArray board;

  Valuator() {
    init_compress();
    /*
    int len = 3;
    for (int i = 1;i <= 8;++i) {
    safety[i - 1] = new SafetyT[len];
    memset(safety[i - 1], 0, len * sizeof(safety[i - 1][0]));
    len = len * 3;
    }
    */
    for (int i = 0;i < 10;++i) board[i] = Empty;
    board[0] = board[9] = Out;
    //    for (int i = 8; i >= 1;--i) CalcValuate(i);
    initValues();

    /*
    len = 4;
    for (int i = 1;i <= 8;++i) {
    printf("safety of length %i\n", len);
    for (int j = 0;j < len;++j) {
    if (safety[i - 1][j]) fprintf(stderr,"%8x ",safety[i - 1][j]);
    }
    len = len * 4;
    }
    */
  }
  ~Valuator() {
  }
  bool move(Square *&undo, int pos, Square color, bool check = false) {
    return ::move(undo, pos, color, board, LineDirections, check);

  }
  void undo(Square *&undo)
  {
    ::undo(undo, board);
  }

  int find_empty(BoardArray in)
  {
    int sum = 0;
    for (int i = 11;i <= 88;++i) sum += empty_sum[in[i]];
    return sum;
  }
  bool quiescent(BoardArray in)
  {
    if (Empty == in[88] && (Empty != in[77] || Empty != in[78]) || Empty != in[87]) return false;
    if (Empty == in[18] && (Empty != in[27] || Empty != in[28] || Empty != in[17])) return false;
    if (Empty == in[11] && (Empty != in[22] || Empty != in[21] || Empty != in[12])) return false;
    if (Empty == in[81] && (Empty != in[72] || Empty != in[71] || Empty != in[82])) return false;
    return true;
  }
  int find_simple_value(BoardArray in, Square root_color)
  {
    int s1 = 0, s2 = 0, s3 = 0, s4 = 0;
    int i;
    {
      //#pragma omp parallel for reduction(+:sum)
      for (i = 11; i <= 85; i += 4) {
        s1 += simple_sum[in[i]];
        s2 += simple_sum[in[1 + i]];
        s3 += simple_sum[in[2 + i]];
        s4 += simple_sum[in[3 + i]];
      }
    }
    //assert(root_color == White);
    const int sum = s1 + s2 + s3 + s4;
    if (root_color == Black) return -sum;
    return sum;
  }
  int find_value(BoardArray in, Square root_color, bool use_move_count, bool display)
  {
    for (int8_t i = 11;i <= 88;++i) aValuationArray[i] = 0;

    CompressedBoard cbs;
    int *store_value_in_table;

    for (int8_t i = 0;i < 8; i += 2) {
      BoardLine c = 0;
      BoardLine c2 = 0;

      for (int8_t j = Valuations[i].pos, j2 = Valuations[1 + i].pos, k = 1;k <= Valuations[i].len;++k, j += Valuations[i].dir, j2 += Valuations[i].dir) {
        c = (c << 2) + in[j];
        c2 = (c2 << 2) + in[j2];

      }

      cbs[i] = compress3(c);
      cbs[i + 1] = compress3(c2);
    }


    for (int8_t i = 0;Valuations[i].pos; i += 2) {
      BoardLine c;
      BoardLine c2;
      if (i < 8) {
        c = safety(Valuations[i].len - 1, cbs[i]);
        c2 = safety(Valuations[i].len - 1, cbs[i + 1]);
      }
      else {
        c = 0;
        c2 = 0;
        for (int8_t j = Valuations[i].pos, j2 = Valuations[1 + i].pos, k = 1;k <= Valuations[i].len;++k, j = j + Valuations[i].dir, j2 = j2 + Valuations[1 + i].dir) {
          c = (c << 2) + in[j];
          c2 = (c2 << 2) + in[j2];
        }
        c = safety(Valuations[i].len - 1, compress3(c));
        c2 = safety(Valuations[i].len - 1, compress3(c2));
      }
      int8_t s = shifts[Valuations[i].dir];
      int8_t s2 = shifts[Valuations[1 + i].dir];
      for (int8_t j = Valuations[i].pos + Valuations[i].dir*(Valuations[i].len - 1),
        j2 = Valuations[1 + i].pos + Valuations[1 + i].dir*(Valuations[i].len - 1),
        k = 1;k <= Valuations[i].len;++k,
        j = j - Valuations[i].dir,
        j2 = j2 - Valuations[1 + i].dir
        ) {
        aValuationArray[j] |= (c & 3) << s;
        aValuationArray[j2] |= (c2 & 3) << s2;
        c >>= 2;
        c2 >>= 2;
      }
    }
    //at this point I should have a board of safety values to flatten
    int32_t sum = 0;
    static int intrans[] = { 0,2,-2,0,0 };
    for (int i = 11;i <= 88;++i) sum += Values[aValuationArray[i]] + intrans[in[i]];
    if (display) {
      const char *p = ".*Ox#";
      Serial.println(F("          1      2      3      4      5      6      7      8"));
      for (int i = 0;i < 100;++i) {
        if (i % 10 == 0) {
          if (i == 0 || i == 90) Serial.print(F("   "));
          else { Serial.print(F(" "));Serial.print(i / 10);Serial.print(F(" ")); }
        }
        Serial.print( //aValuationArray[i],
          Values[aValuationArray[i]] + intrans[in[i]]);Serial.print(p[in[i]]);Serial.print(F(" "));
        if (i % 10 == 9) {Serial.println(F(""));      }
      }

    }
    if (use_move_count) {
      int32_t white_moves = 0, black_moves = 0;
      for (int8_t p = 11;p <= 88;++p) if (fast_move_check(p, White, in))white_moves += 7;
      for (int8_t p = 11;p <= 88;++p) if (fast_move_check(p, Black, in))black_moves += 7;

      /*
      for (int p = 11;p <= 88;++p) {
      bool m = fast_move_check(p, White, in);
      assert(m ==
      ::move(undo_buffer, p, White, in, Directions, true));

      if (m) {
      white_moves += 7;
      }
      }
      for (int p = 11;p <= 88;++p) {
      bool m = fast_move_check(p, Black, in);
      assert(m == ::move(undo_buffer, p, Black, in, Directions, true));
      if (m) {
      black_moves += 7;
      }
      }
      */

      if (white_moves < 2 && black_moves>white_moves) black_moves <<= 2 - white_moves;
      else if (black_moves < 2 && white_moves>black_moves) white_moves <<= 2 - black_moves;
      sum = sum + white_moves - black_moves;

      if (white_moves == 0 && black_moves == 0) {
        if (find_simple_value(in, root_color) < 0) sum = -100000;
        else sum = 100000;

        //        *store_value_in_table = sum;
        //        printf("end of game %i \n",sum);
        return sum;
      }
    }
    ///*

    //11 12 13 14 15 16 17 18
    //21 22 23 24 25 26 27 28
    //31 32 33 34 35 36 37 38
    //41 42 43 44 45 46 47 48
    //51 52 53 54 55 56 57 58
    //61 62 63 64 65 66 67 68
    //71 72 73 74 75 76 77 78
    //81 82 83 84 85 86 87 88


    const int8_t corner_fix2[] = { 11,18,81,88 };
    for (int8_t i = 0;i < 4;++i) {
      if (board[corner_fix2[i]] == White) sum += 1800; else sum -= 1800;
    }


    //setup scoring
    const int8_t corner_fix4[] = { 11,12,22,21,18,17,27,28,81,71,72,82,88,78,77,87 };
    for (int8_t i = 0;i < 16;i += 4) {
      if (board[corner_fix4[i]] == Empty) {
        if (corner_fix4[i + 1] == White) sum -= 450;
        else if (corner_fix4[i + 1] == White) sum += 450;
        else {
          if (move(undo_buffer, corner_fix4[i + 1], White, true)) sum -= 160;
          if (move(undo_buffer, corner_fix4[i + 1], Black, true)) sum += 160;
        }

        if (corner_fix4[i + 3] == White) sum -= 450;
        else if (corner_fix4[i + 3] == White) sum += 450;
        else {
          if (move(undo_buffer, corner_fix4[i + 3], White, true)) sum -= 160;
          if (move(undo_buffer, corner_fix4[i + 3], Black, true)) sum += 160;
        }

        if (corner_fix4[i + 2] == White) sum -= 800;
        else if (corner_fix4[i + 2] == White) sum += 800;
        else {
          if (move(undo_buffer, corner_fix4[i + 2], White, true)) sum -= 500;
          if (move(undo_buffer, corner_fix4[i + 2], Black, true)) sum += 500;
        }
      }
    }

    //*/


    //    assert(root_color == White);
    if (root_color == Black) sum = -sum;
    //? how to count options?
    //    *store_value_in_table = sum;
    //    printf("%i\n", sum);
    return sum;
  }

#define NUM_PRIMARY 4
#define NUM_PRIMARY_MAX (2*NUM_PRIMARY)


  const int8_t inner_corners[4] = { 22,27,72,77 };
  const int8_t corners[4] = { 11,18,81,88 };
  void remove_dangerous_moves(int32_t *moves, BoardArray in, Square color)
  {

    //11 12 13 14 15 16 17 18
    //21 22 23 24 25 26 27 28
    //31 32 33 34 35 36 37 38
    //41 42 43 44 45 46 47 48
    //51 52 53 54 55 56 57 58
    //61 62 63 64 65 66 67 68
    //71 72 73 74 75 76 77 78
    //81 82 83 84 85 86 87 88
    /*
    if corner not taken then any move that sets in from corner to my color is dangerous
    any that makes side gap is slightly dangerous - hard to test
    any that sets side to my corner is very slightly dangerous
    */
    bool danger[NUM_PRIMARY_MAX + 1];
    bool corners_not_taken[4] = { in[11] == Empty,in[18] == Empty,in[81] == Empty,in[88] == Empty };
    bool inner_corners_not_taken[4] = { in[22] != color,in[27] != color,in[72] != color,in[77] != color };
    int count = 0;
    for (int i = 1;i <= moves[0];++i) {
      //::move(undo_buffer, moves[i], color, in, Directions);
      fast_move(undo_buffer, moves[i], color, in);
      bool dangerous = false;
      for (int c = 0;c < 4;++c) {
        if (corners_not_taken[c] && inner_corners_not_taken[c] && in[inner_corners[c]] == color && in[corners[c]] != color
          ) {
          dangerous = true;
          ++count;
          break;
        }
      }
      ::undo(undo_buffer, in);
      danger[i] = dangerous;
    }
    if (count == 0 || count == moves[0]) return;
    int copy[NUM_PRIMARY_MAX + 1];

    for (int i = 0;i <= moves[0];++i) copy[i] = moves[i];
    moves[0] = 0;
    int j = 1;
    for (int i = 1;i <= copy[0];++i)
      if (!danger[i]) {
        ++moves[0];
        moves[moves[0]] = copy[i];
      }

  }
};

Valuator valuator;
bool in_endgame = false;

int Board::find_move(int depth, Square color, bool use_move_count)
{
#ifdef SIMPLE_SEARCH
  int empty_depth = valuator.find_empty(board);
  int moveAt = 0;
  if (empty_depth < 19) {
    printf(F("endgame "));
    endgame_alphabeta(moveAt, empty_depth, -INT_MAX, INT_MAX, color, color, false);
  }
  else alphabeta(moveAt, depth, -INT_MAX, INT_MAX, color, color, use_move_count);
  return moveAt;
#else
//Serial.println(F("before find empty"));
  int empty_depth = valuator.find_empty(board);
//Serial.println(F("after find empty"));
  int moveAt = 0;
  if (empty_depth < 13) {
    Serial.println(F("endgame "));
    if (in_endgame == false) {
      in_endgame = true;

    }
    endgame_alphabeta(moveAt, empty_depth, -INT_MAX, INT_MAX, color, color, false);
    return moveAt;
  }
  in_endgame = false;
  int32_t move_collection[NUM_PRIMARY_MAX + 1];

  // ed = 24/24  ed=26/22 ed=28/20 ed=30/18 
  //prime the endgame refutation
  //  int endgame_reflect = 48 - empty_depth;
  //  if (endgame_reflect>0 ) endgame_alphabeta(moveAt, endgame_reflect, -INT_MAX, INT_MAX, color, color, false);
//Serial.println(F("before find collect_primary_alphabeta"));
  if (collect_primary_alphabeta(NUM_PRIMARY, NUM_PRIMARY_MAX, move_collection, depth - 2, color, color, use_move_count)) {
//Serial.println(F("after find collect_primary_alphabeta"));

    valuator.remove_dangerous_moves(move_collection, board, color);
    //undo(undo_buffer, board);
    movelist_alphabeta(move_collection, moveAt, depth, color, color, use_move_count);
    //alphabeta(moveAt, depth, -INT_MAX, INT_MAX, color, color, use_move_count);
    return moveAt;
  }
  return 0;
  //bool Board::collect_primary_alphabeta(int collect, int * move_collection, int depth, Square color, Square root_color, bool use_move_count)

#endif
}

int32_t Board::endgame_alphabeta(int &move_at, int depth, int32_t alpha, int32_t beta, Square color, Square root_color, bool passed)
{
  if (depth <= 0) {
    return valuator.find_simple_value(board, root_color);
  }
  int at, move_number = 0;
  int inner_move;
  if (color == root_color) { //maximizing
    int32_t v = -INT_MAX;
    while (endgame_next_move(move_number, at, color, depth)) {

      int32_t n = endgame_alphabeta(inner_move, depth - 1, alpha, beta, other_color(color), root_color);
      if (n > v) {
        v = n;
        move_at = at;
        endgame_killer(move_number - 1, color, depth);
      }
      if (v > alpha) {
        alpha = v;
      }

      undo(undo_buffer, board);
      if (beta <= alpha) {
        break; //cut off
      }
    }
    if (v == -INT_MAX) {
      if (passed) return valuator.find_simple_value(board, root_color);
      move_at = 0;
      return endgame_alphabeta(inner_move, depth, alpha, beta, other_color(color), root_color, true);//passed
    }
    return v;
  }
  else {//minimizing
    int32_t v = INT_MAX;
    while (endgame_next_move(move_number, at, color, depth)) {
      int32_t n = endgame_alphabeta(inner_move, depth - 1, alpha, beta, other_color(color), root_color);
      if (n < v) {
        v = n;
        move_at = at;
        endgame_killer(move_number - 1, color, depth);
      }
      if (v < beta) {
        beta = v;
      }
      undo(undo_buffer, board);
      if (beta <= alpha) {
        break; //cut off
      }
    }
    if (v == INT_MAX) {
      if (passed) return valuator.find_simple_value(board, root_color);
      move_at = 0;
      return endgame_alphabeta(inner_move, depth, alpha, beta, other_color(color), root_color, true);//passed
    }
    move_at = at;
  }

};



bool Board::collect_primary_alphabeta(int32_t collect, int32_t collect_max, int32_t * move_collection, int depth, Square color, Square root_color, bool use_move_count)
{
  int current_move_pos = 0;
  do {
    int32_t alpha = -INT_MAX;
    int32_t beta = INT_MAX;
    move_collection[0] = ++current_move_pos;
    move_collection[current_move_pos] = 0;
    //depth will never be zero at this level
    int at, move_number = 0;
    int  inner_move;
    if (color == root_color) { //maximizing
      int32_t v = -INT_MAX;
      while (next_move_not_in(move_collection, move_number, at, color, depth)) {
//dump_undos();
//print();
        int32_t n = alphabeta(inner_move, depth - 1, alpha, beta, other_color(color), root_color, use_move_count);
//dump_undos();
        if (n > v) {
          //just take bonehead move out of the list if there's an alt
          //* 
          if (at == 22 || at == 27 || at == 77 || at == 72) collect = __min(collect_max, collect + 1);
          //*/
          v = n;
          move_collection[current_move_pos] = at;
          //          killer(move_number - 1, color);
        }
        if (v > alpha) {
          alpha = v;
        }

        undo(undo_buffer, board);
        if (beta <= alpha) {
          break; //cut off
        }
      }
      if (v == -INT_MAX) {
        //        move_collection[current_move_pos] = 0;
// dump_undos();       
        v = alphabeta(inner_move, depth - 1, alpha, beta, other_color(color), root_color, use_move_count);//passed
//dump_undos();
        continue;
      }
      continue;
    }
    else {//minimizing
      int32_t v = INT_MAX;
      while (next_move_not_in(move_collection, move_number, at, color, depth)) {
        int32_t n = alphabeta(inner_move, depth - 1, alpha, beta, other_color(color), root_color, use_move_count);
        //{}{}{} getting an extra undo somewhere
        if (n < v) {
          //just take bonehead move out of the list if there's an alt
          //*
          if (at == 22 || at == 27 || at == 77 || at == 72) collect = __min(collect_max, collect + 1);
          //*/
          v = n;
          move_collection[current_move_pos] = at;
          //          killer(move_number - 1, color);
        }
        if (v < beta) {
          beta = v;
        }
        undo(undo_buffer, board);
        if (beta <= alpha) {
          break; //cut off
        }
      }
      if (v == INT_MAX) {
        //        move_collection[current_move_pos] = 0;
        v = alphabeta(inner_move, depth - 1, alpha, beta, other_color(color), root_color, use_move_count);//passed
        continue;
      }
      move_collection[current_move_pos] = at;
      continue;
    }
  } while (current_move_pos < collect);
  while (move_collection[0] != 0 && move_collection[move_collection[0]] == 0) {
    --move_collection[0];
  }
  return move_collection[0] != 0;
}

int32_t Board::movelist_alphabeta(int32_t* move_collection, int &move_at, int depth, Square color, Square root_color, bool use_move_count)
{
  int32_t alpha = -INT_MAX;
  int32_t beta = INT_MAX;
  int at, move_number = 0;
  int move_list_counter = 0;
  int inner_move;
  if (color == root_color) { //maximizing
    int32_t v = -INT_MAX;
    while (++move_list_counter <= move_collection[0]) {
      at = move_collection[move_list_counter];
      bool moved = move(undo_buffer, at, color);
//dump_undos();      
      int32_t n = alphabeta(inner_move, depth - 1, alpha, beta, other_color(color), root_color, use_move_count);
      if (n > v) {
        v = n;
        move_at = at;
        //        killer(move_number - 1, color);
      }
      if (v > alpha) {
        alpha = v;
      }

      undo(undo_buffer, board);
      if (beta <= alpha) {
        break; //cut off
      }
    }
    if (v == -INT_MAX) {
      move_at = 0;
      return alphabeta(inner_move, depth - 1, alpha, beta, other_color(color), root_color, use_move_count);//passed
    }
    return v;
  }
  else {//minimizing
    int32_t v = INT_MAX;
    while (++move_list_counter <= move_collection[0]) {
      at = move_collection[move_list_counter];
      bool moved = move(undo_buffer, at, color);
//dump_undos();      
      int32_t n = alphabeta(inner_move, depth - 1, alpha, beta, other_color(color), root_color, use_move_count);
      if (n < v) {
        v = n;
        move_at = at;
        //        killer(move_number - 1, color);
      }
      if (v < beta) {
        beta = v;
      }
      undo(undo_buffer, board);
      if (beta <= alpha) {
        break; //cut off
      }
    }
    if (v == INT_MAX) {
      move_at = 0;
      return alphabeta(inner_move, depth - 1, alpha, beta, other_color(color), root_color, use_move_count);//passed
    }
    move_at = at;
    return v;
  }

}


int32_t Board::alphabeta(int &move_at, int depth, int32_t alpha, int32_t beta, Square color, Square root_color, bool use_move_count)
{
#if (QUIESCENT_DEPTH!=0)
  if (depth == -QUIESCENT_DEPTH || (depth <= 0 && valuator.quiescent(board)) || end_of_game()) {
#else
  if (depth <= 0 || end_of_game()) {
#endif
    return valuator.find_value(board, root_color, use_move_count, false);//display
  }
  int at, move_number = 0;
  int inner_move;
  if (color == root_color) { //maximizing
    int32_t v = -INT_MAX;
    while (next_move(move_number, at, color, depth)) {
dump_undos();
//Serial.print(F("alphabeta "));Serial.println(depth);
//    print();
      int32_t *to_store, n;
      //{}{}{} rewrite to fill only on no cut wait would that have to be 
      //recursive?  Needs more research
      //      if (TranspositionEntry::find_and_fill(to_store, board, depth)) {
      //        n = *to_store;
      //      }
      //      else {
      n = alphabeta(inner_move, depth - 1, alpha, beta, other_color(color), root_color, use_move_count);
//dump_undos();
      //        *to_store = n;
      //      }
      if (n > v) {
        v = n;
        move_at = at;
        killer(move_number - 1, color, depth);
      }
      if (v > alpha) {
        alpha = v;
      }

      undo(undo_buffer, board);
      if (beta <= alpha) {
        break; //cut off
      }
    }
    if (v == -INT_MAX) {
      move_at = 0;
      return alphabeta(inner_move, depth - 1, alpha, beta, other_color(color), root_color, use_move_count);//passed
    }
    return v;
  }
  else {//minimizing
    int32_t v = INT_MAX;
    while (next_move(move_number, at, color, depth)) {
//Serial.print(F("alphabeta "));Serial.println(depth);
//    print();
//dump_undos();
      int32_t *to_store, n;
      //      if (TranspositionEntry::find_and_fill(to_store, board, depth)) {
      //        n = *to_store;
      //      }
      //      else {
      n = alphabeta(inner_move, depth - 1, alpha, beta, other_color(color), root_color, use_move_count);
//dump_undos();
      //        *to_store = n;
      //      }
      if (n < v) {
        v = n;
        move_at = at;
        killer(move_number - 1, color, depth);
      }
      if (v < beta) {
        beta = v;
      }
      undo(undo_buffer, board);
      if (beta <= alpha) {
        break; //cut off
      }
    }
    if (v == INT_MAX) {
      move_at = 0;
      return alphabeta(inner_move, depth - 1, alpha, beta, other_color(color), root_color, use_move_count);//passed
    }
    move_at = at;
    return v;
  }

  }



void setup() 
{
  pinMode(13, OUTPUT);  
  Serial.begin(9600);
  while (!Serial) {
    ; // wait for serial port to connect. Needed for native USB port only
  }

  Serial.println(F("Hello World"));

  Board b;
  Serial.println(F("board"));
  
  bool black_passed;
  bool white_passed;
  do {
    if (!b.can_move(Black)) {
      if (white_passed) {
        Serial.println("game over");
        break;
      }
      Serial.println("Black must pass");
      black_passed = true;
    }
      else {
        b.input(Black, "b6");
      black_passed = false;
    }
    //increment_killers();
//    valuator.find_value(b.board, White,false, true);
    if (!b.can_move(White)) {
      if (black_passed) {
        Serial.println("game over");
        break;
      }
      Serial.println("White must pass");
      white_passed = true;
    }
    else {
      b.input(White);
      white_passed = false;
    }
    //increment_killers();
    //    valuator.find_value(b.board, Black, false,true);
  } while (true);
  b.print();
 
  // compute and print the elapsed time in millisec
}




void loop() {
  // put your main code here, to run repeatedly:

}
